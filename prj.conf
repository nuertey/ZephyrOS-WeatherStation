## CMakeLists.txt
```
#
# Copyright (c) 2019 Nordic Semiconductor ASA
#
# SPDX-License-Identifier: Apache-2.0
#

cmake_minimum_required(VERSION 3.20.0)
find_package(Zephyr REQUIRED HINTS $ENV{ZEPHYR_BASE})
project(dht11_and_lcd16x2)

FILE(GLOB app_sources src/*.c)
target_sources(app PRIVATE ${app_sources})
```

## Kconfig
```
# Config options for dht11_and_lcd16x2 application

# Copyright (c) 2020 Intel Corporation
# SPDX-License-Identifier: Apache-2.0

mainmenu "dht11_and_lcd16x2 application"

config NET_SAMPLE_APP_MAX_ITERATIONS
    int "Number of times to Publish sample MQTT messages"
    default 500
    help
      Send sample MQTT messages this many times in a MQTT connection
      before exiting. A value of zero means that the messages are sent
      forever.

config NET_SAMPLE_APP_MAX_CONNECTIONS
    int "Number of times to connect to the MQTT server"
    default 0
    help
      Number of times to connect to the MQTT server. With each connection
      send NET_SAMPLE_APP_MAX_ITERATIONS amount of MQTT sample messages.
      A value of zero means to continue forever.

source "Kconfig.zephyr"
```

## prj.conf
```kconfig
#
# Copyright (c) 2019 Nordic Semiconductor ASA
#
# SPDX-License-Identifier: Apache-2.0
#

CONFIG_SENSOR=y
CONFIG_GPIO=y

# Need float format support
CONFIG_NEWLIB_LIBC=y
CONFIG_NEWLIB_LIBC_NANO=n
CONFIG_NEWLIB_LIBC_FLOAT_PRINTF=y
CONFIG_CBPRINTF_FP_SUPPORT=y

CONFIG_NETWORKING=y
CONFIG_NET_SOCKETS=y
CONFIG_NET_TCP=y
CONFIG_NET_LOG=y

CONFIG_NET_IPV6_RA_RDNSS=y
CONFIG_NET_IF_UNICAST_IPV6_ADDR_COUNT=3
CONFIG_NET_IF_MCAST_IPV6_ADDR_COUNT=2

CONFIG_PRINTK=y
CONFIG_STDOUT_CONSOLE=y

# Enable IPv6 support
CONFIG_NET_IPV6=n
# Enable IPv4 support
CONFIG_NET_IPV4=y

# Enable the MQTT Lib
CONFIG_MQTT_LIB=y

CONFIG_NET_CONFIG_SETTINGS=y
CONFIG_NET_CONFIG_MY_IPV6_ADDR="2001:db8::1"
CONFIG_NET_CONFIG_PEER_IPV6_ADDR="2001:db8::2"

CONFIG_NET_CONFIG_MY_IPV4_ADDR="10.42.0.2"
CONFIG_NET_CONFIG_PEER_IPV4_ADDR="10.42.0.1"

CONFIG_MAIN_STACK_SIZE=2048

# For IPv6
CONFIG_NET_BUF_DATA_SIZE=256

CONFIG_NET_SHELL=y

CONFIG_ENTROPY_GENERATOR=y
CONFIG_TEST_RANDOM_GENERATOR=y
```

## boards/nucleo_f767zi.overlay
```dts
/*
 * Copyright (c) 2022 Nuertey Odzeyem
 *
 * SPDX-License-Identifier: Apache-2.0
 */

/ {
    dht22 {
        compatible = "aosong,dht";
        status = "okay";
        dio-gpios = <&gpioe 13 (GPIO_PULL_UP | GPIO_ACTIVE_LOW)>;
    };
};
```

## src/main.c
```c
/*
 * Copyright (c) 2022 Nuertey Odzeyem
 *
 * SPDX-License-Identifier: Apache-2.0
 */
#include "lcd16x2.h"
#include "mqtt_publisher.h"
#include <zephyr/device.h>
#include <zephyr/drivers/sensor.h>
#include <stdio.h>

LOG_MODULE_DECLARE(dht11_and_lcd16x2, LOG_LEVEL_DBG);

static const char *now_str(void)
{
    static char buf[16]; /* ...HH:MM:SS.MMM */
    uint32_t now = k_uptime_get_32();
    unsigned int ms = now % MSEC_PER_SEC;
    unsigned int s;
    unsigned int min;
    unsigned int h;

    now /= MSEC_PER_SEC;
    s = now % 60U;
    now /= 60U;
    min = now % 60U;
    now /= 60U;
    h = now;

    snprintf(buf, sizeof(buf), "%u:%02u:%02u.%03u", h, min, s, ms);
    return buf;
}

void main(void)
{
    const struct device *const dht22 = DEVICE_DT_GET_ONE(aosong_dht);

    if (!device_is_ready(dht22))
    {
        printf("Device %s is not ready\n", dht22->name);
        printf("Exiting application...\n");
        return;
    }

    const struct device *const gpio_dev = DEVICE_DT_GET(GPIO_NODE);

    if (!device_is_ready(gpio_dev))
    {
        printk("Device %s not ready!\n", gpio_dev->name);
        printf("Exiting application...\n");
        return;
    }

    /* Setup GPIO output to the LCD16x2 */
    GPIO_PIN_CFG(gpio_dev, GPIO_PIN_E,  GPIO_OUTPUT);
    GPIO_PIN_CFG(gpio_dev, GPIO_PIN_RS, GPIO_OUTPUT);
    GPIO_PIN_CFG(gpio_dev, GPIO_PIN_D4, GPIO_OUTPUT);
    GPIO_PIN_CFG(gpio_dev, GPIO_PIN_D5, GPIO_OUTPUT);
    GPIO_PIN_CFG(gpio_dev, GPIO_PIN_D6, GPIO_OUTPUT);
    GPIO_PIN_CFG(gpio_dev, GPIO_PIN_D7, GPIO_OUTPUT);
    
    int result = -1;

    LOG_INF("Attempting to connect: ");
    result = try_to_connect(&client_ctx);
    PRINT_RESULT("try_to_connect", result);
    SUCCESS_OR_EXIT(result);

    printk("LCD Init\n");
    pi_lcd_init(gpio_dev, 16, 2, LCD_5x8_DOTS);

    printk("Outputting initial LCD16x2 welcome message...\n");

    /* Clear display */
    pi_lcd_clear(gpio_dev);
    pi_lcd_set_cursor(gpio_dev, 0, 0);
    pi_lcd_string(gpio_dev, "Nuertey Odzeyem");
    pi_lcd_set_cursor(gpio_dev, 0, 1);
    pi_lcd_string(gpio_dev, "NUCLEO F767ZI");
    k_msleep(MSEC_PER_SEC * 5U);

    while (true)
    {
        int rc = sensor_sample_fetch(dht22);

        if (rc != 0)
        {
            printf("DHT11 Sensor fetch failed: %d\n", rc);
            printf("Exiting application...\n");
            break;
        }

        struct sensor_value temperature;
        struct sensor_value humidity;

        rc = sensor_channel_get(dht22, SENSOR_CHAN_AMBIENT_TEMP, &temperature);
        if (rc == 0)
        {
            rc = sensor_channel_get(dht22, SENSOR_CHAN_HUMIDITY, &humidity);
            if (rc != 0)
            {
                printf("Sensor humidity retrieval failed: %d\n", rc);
                printf("Exiting application...\n");
                break;              
            }
        }
        else 
        {
            printf("Sensor ambient temperature retrieval failed: %d\n", rc);
            printf("Exiting application...\n");
            break;
        }

        printf("[%s]: %.2f °C ; %.2f %%RH\n", now_str(), sensor_value_to_double(&temperature),
            sensor_value_to_double(&humidity));
            
        char tempBuffer[16];
        char humiBuffer[16];
        char tempBuffer2[100];
        char humiBuffer2[100];
        snprintf(tempBuffer, sizeof(tempBuffer), "%.2f °C", sensor_value_to_double(&temperature));
        snprintf(humiBuffer, sizeof(humiBuffer), "%.2f %%RH", sensor_value_to_double(&humidity));
        snprintf(tempBuffer2, sizeof(tempBuffer2), "%f", sensor_value_to_double(&temperature));
        snprintf(humiBuffer2, sizeof(humiBuffer2), "%f", sensor_value_to_double(&humidity));

        pi_lcd_clear(gpio_dev);
        pi_lcd_set_cursor(gpio_dev, 0, 0);
        pi_lcd_string(gpio_dev, tempBuffer);
        pi_lcd_set_cursor(gpio_dev, 0, 1);
        pi_lcd_string(gpio_dev, humiBuffer);
        
        int result2 = -1;
        
        result2 = publish(&client_ctx, NUCLEO_F767ZI_DHT11_IOT_MQTT_TOPIC1, tempBuffer2);
        PRINT_RESULT("mqtt_publish temperature", result2);
        SUCCESS_OR_BREAK(result2);

        result2 = process_mqtt_and_sleep(&client_ctx, APP_SLEEP_MSECS);
        SUCCESS_OR_BREAK(result2);

        result2 = publish(&client_ctx, NUCLEO_F767ZI_DHT11_IOT_MQTT_TOPIC2, humiBuffer2);
        PRINT_RESULT("mqtt_publish humidity", result2);
        SUCCESS_OR_BREAK(result2);

        result2 = process_mqtt_and_sleep(&client_ctx, APP_SLEEP_MSECS);
        SUCCESS_OR_BREAK(result2);
            
        k_sleep(K_SECONDS(300)); // 5 minutes is reasonable for any discernable change.
    }
    
    result = mqtt_disconnect(&client_ctx);
    PRINT_RESULT("mqtt_disconnect", result);

    LOG_INF("Bye!");
}
```

## src/config.h
```c
/*
 * Copyright (c) 2017 Intel Corporation
 *
 * SPDX-License-Identifier: Apache-2.0
 */
#pragma once

#ifdef CONFIG_NET_CONFIG_SETTINGS
#ifdef CONFIG_NET_IPV6
#define ZEPHYR_ADDR     CONFIG_NET_CONFIG_MY_IPV6_ADDR
#define SERVER_ADDR     CONFIG_NET_CONFIG_PEER_IPV6_ADDR
#else
#define ZEPHYR_ADDR     CONFIG_NET_CONFIG_MY_IPV4_ADDR
#define SERVER_ADDR     CONFIG_NET_CONFIG_PEER_IPV4_ADDR
#endif
#else
#ifdef CONFIG_NET_IPV6
#define ZEPHYR_ADDR     "2001:db8::1"
#define SERVER_ADDR     "2001:db8::2"
#else
#define ZEPHYR_ADDR     "10.42.0.2"
#define SERVER_ADDR     "10.42.0.1"
#endif
#endif

#if defined(CONFIG_SOCKS)
#define SOCKS5_PROXY_ADDR   SERVER_ADDR
#define SOCKS5_PROXY_PORT   1080
#endif

#ifdef CONFIG_MQTT_LIB_TLS
#ifdef CONFIG_MQTT_LIB_WEBSOCKET
#define SERVER_PORT     9001
#else
#define SERVER_PORT     8883
#endif /* CONFIG_MQTT_LIB_WEBSOCKET */
#else
#ifdef CONFIG_MQTT_LIB_WEBSOCKET
#define SERVER_PORT     9001
#else
#define SERVER_PORT     1883
#endif /* CONFIG_MQTT_LIB_WEBSOCKET */
#endif

#define APP_CONNECT_TIMEOUT_MS  2000
#define APP_SLEEP_MSECS     500

#define APP_CONNECT_TRIES   10

#define APP_MQTT_BUFFER_SIZE    128

#define MQTT_CLIENTID       "zephyr_publisher"

#define NUCLEO_F767ZI_DHT11_IOT_MQTT_TOPIC1   "/Nuertey/Nucleo/F767ZI/Temperature"
#define NUCLEO_F767ZI_DHT11_IOT_MQTT_TOPIC2   "/Nuertey/Nucleo/F767ZI/Humidity"
```

## src/lcd16x2.c
```c
/*
 * Copyright (c) 2022 Nuertey Odzeyem
 *
 * SPDX-License-Identifier: Apache-2.0
 */

#include "lcd16x2.h"

struct pi_lcd_data
{
    uint8_t disp_func;  /* Display Function */
    uint8_t disp_cntl;  /* Display Control */
    uint8_t disp_mode;  /* Display Mode */
    uint8_t cfg_rows;
    uint8_t row_offsets[2];
};

/* Default Configuration - User can update */
struct pi_lcd_data lcd_data =
{
    .disp_func = LCD_4BIT_MODE | LCD_2_LINE | LCD_5x8_DOTS,
    .disp_cntl = 0,
    .disp_mode = 0,
    .cfg_rows = 0,
    .row_offsets = {0x00, 0x00}
};

void _set_row_offsets(int8_t row0, int8_t row1)
{
    lcd_data.row_offsets[0] = row0;
    lcd_data.row_offsets[1] = row1;
}

void _pi_lcd_toggle_enable(const struct device *gpio_dev)
{
    GPIO_PIN_WR(gpio_dev, GPIO_PIN_E, LOW);
    k_msleep(ENABLE_DELAY);
    GPIO_PIN_WR(gpio_dev, GPIO_PIN_E, HIGH);
    k_msleep(ENABLE_DELAY);
    GPIO_PIN_WR(gpio_dev, GPIO_PIN_E, LOW);
    k_msleep(ENABLE_DELAY);
}

void _pi_lcd_4bits_wr(const struct device *gpio_dev, uint8_t bits)
{
    /* High bits */
    GPIO_PIN_WR(gpio_dev, GPIO_PIN_D4, LOW);
    GPIO_PIN_WR(gpio_dev, GPIO_PIN_D5, LOW);
    GPIO_PIN_WR(gpio_dev, GPIO_PIN_D6, LOW);
    GPIO_PIN_WR(gpio_dev, GPIO_PIN_D7, LOW);
    if ((bits & BIT(4)) == BIT(4))
    {
        GPIO_PIN_WR(gpio_dev, GPIO_PIN_D4, HIGH);
    }
    if ((bits & BIT(5)) == BIT(5))
    {
        GPIO_PIN_WR(gpio_dev, GPIO_PIN_D5, HIGH);
    }
    if ((bits & BIT(6)) == BIT(6))
    {
        GPIO_PIN_WR(gpio_dev, GPIO_PIN_D6, HIGH);
    }
    if ((bits & BIT(7)) == BIT(7))
    {
        GPIO_PIN_WR(gpio_dev, GPIO_PIN_D7, HIGH);
    }

    /* Toggle 'Enable' pin */
    _pi_lcd_toggle_enable(gpio_dev);

    /* Low bits */
    GPIO_PIN_WR(gpio_dev, GPIO_PIN_D4, LOW);
    GPIO_PIN_WR(gpio_dev, GPIO_PIN_D5, LOW);
    GPIO_PIN_WR(gpio_dev, GPIO_PIN_D6, LOW);
    GPIO_PIN_WR(gpio_dev, GPIO_PIN_D7, LOW);
    if ((bits & BIT(0)) == BIT(0))
    {
        GPIO_PIN_WR(gpio_dev, GPIO_PIN_D4, HIGH);
    }
    if ((bits & BIT(1)) == BIT(1))
    {
        GPIO_PIN_WR(gpio_dev, GPIO_PIN_D5, HIGH);
    }
    if ((bits & BIT(2)) == BIT(2))
    {
        GPIO_PIN_WR(gpio_dev, GPIO_PIN_D6, HIGH);
    }
    if ((bits & BIT(3)) == BIT(3))
    {
        GPIO_PIN_WR(gpio_dev, GPIO_PIN_D7, HIGH);
    }

    /* Toggle 'Enable' pin */
    _pi_lcd_toggle_enable(gpio_dev);
}

void _pi_lcd_8bits_wr(const struct device *gpio_dev, uint8_t bits)
{
    /* High bits */
    GPIO_PIN_WR(gpio_dev, GPIO_PIN_D7, LOW);
    GPIO_PIN_WR(gpio_dev, GPIO_PIN_D6, LOW);
    GPIO_PIN_WR(gpio_dev, GPIO_PIN_D5, LOW);
    GPIO_PIN_WR(gpio_dev, GPIO_PIN_D4, LOW);
    GPIO_PIN_WR(gpio_dev, GPIO_PIN_D3, LOW);
    GPIO_PIN_WR(gpio_dev, GPIO_PIN_D2, LOW);
    GPIO_PIN_WR(gpio_dev, GPIO_PIN_D1, LOW);
    GPIO_PIN_WR(gpio_dev, GPIO_PIN_D0, LOW);

    /* Low bits */
    if ((bits & BIT(0)) == BIT(0))
    {
        GPIO_PIN_WR(gpio_dev, GPIO_PIN_D0, HIGH);
    }
    if ((bits & BIT(1)) == BIT(1))
    {
        GPIO_PIN_WR(gpio_dev, GPIO_PIN_D1, HIGH);
    }
    if ((bits & BIT(2)) == BIT(2))
    {
        GPIO_PIN_WR(gpio_dev, GPIO_PIN_D2, HIGH);
    }
    if ((bits & BIT(3)) == BIT(3))
    {
        GPIO_PIN_WR(gpio_dev, GPIO_PIN_D3, HIGH);
    }
    if ((bits & BIT(4)) == BIT(4))
    {
        GPIO_PIN_WR(gpio_dev, GPIO_PIN_D4, HIGH);
    }
    if ((bits & BIT(5)) == BIT(5))
    {
        GPIO_PIN_WR(gpio_dev, GPIO_PIN_D5, HIGH);
    }
    if ((bits & BIT(6)) == BIT(6))
    {
        GPIO_PIN_WR(gpio_dev, GPIO_PIN_D6, HIGH);
    }
    if ((bits & BIT(7)) == BIT(7))
    {
        GPIO_PIN_WR(gpio_dev, GPIO_PIN_D7, HIGH);
    }

    /* Toggle 'Enable' pin */
    _pi_lcd_toggle_enable(gpio_dev);
}

void _pi_lcd_data(const struct device *gpio_dev, uint8_t bits)
{
    if (lcd_data.disp_func & LCD_8BIT_MODE)
    {
        _pi_lcd_8bits_wr(gpio_dev, bits);
    }
    else
    {
        _pi_lcd_4bits_wr(gpio_dev, bits);
    }
}

void _pi_lcd_command(const struct device *gpio_dev, uint8_t bits)
{
    /* mode = False for command */
    GPIO_PIN_WR(gpio_dev, GPIO_PIN_RS, LOW);
    _pi_lcd_data(gpio_dev, bits);
}

void _pi_lcd_write(const struct device *gpio_dev, uint8_t bits)
{
    /* mode = True for character */
    GPIO_PIN_WR(gpio_dev, GPIO_PIN_RS, HIGH);
    _pi_lcd_data(gpio_dev, bits);
}

/*************************
 * USER can use these APIs
 *************************/
/** Home */
void pi_lcd_home(const struct device *gpio_dev)
{
    _pi_lcd_command(gpio_dev, LCD_RETURN_HOME);
    k_sleep(K_MSEC(2));         /* wait for 2ms */
}

/** Set cursor position */
void pi_lcd_set_cursor(const struct device *gpio_dev, uint8_t col,
                       uint8_t row)
{
    size_t max_lines;

    max_lines = ARRAY_SIZE(lcd_data.row_offsets);
    if (row >= max_lines)
    {
        row = max_lines - 1;    /* Count rows starting w/0 */
    }
    if (row >= lcd_data.cfg_rows)
    {
        row = lcd_data.cfg_rows - 1;    /* Count rows starting w/0 */
    }
    _pi_lcd_command(gpio_dev, (LCD_SET_DDRAM_ADDR | (col + lcd_data.row_offsets[row])));
}

/** Clear display */
void pi_lcd_clear(const struct device *gpio_dev)
{
    _pi_lcd_command(gpio_dev, LCD_CLEAR_DISPLAY);
    k_sleep(K_MSEC(2));         /* wait for 2ms */
}

/** Display ON */
void pi_lcd_display_on(const struct device *gpio_dev)
{
    lcd_data.disp_cntl |= LCD_DISPLAY_ON;
    _pi_lcd_command(gpio_dev,
                    LCD_DISPLAY_CONTROL | lcd_data.disp_cntl);
}

/** Display OFF */
void pi_lcd_display_off(const struct device *gpio_dev)
{
    lcd_data.disp_cntl &= ~LCD_DISPLAY_ON;
    _pi_lcd_command(gpio_dev,
                    LCD_DISPLAY_CONTROL | lcd_data.disp_cntl);
}

/** Turns cursor off */
void pi_lcd_cursor_off(const struct device *gpio_dev)
{
    lcd_data.disp_cntl &= ~LCD_CURSOR_ON;
    _pi_lcd_command(gpio_dev,
                    LCD_DISPLAY_CONTROL | lcd_data.disp_cntl);
}

/** Turn cursor on */
void pi_lcd_cursor_on(const struct device *gpio_dev)
{
    lcd_data.disp_cntl |= LCD_CURSOR_ON;
    _pi_lcd_command(gpio_dev,
                    LCD_DISPLAY_CONTROL | lcd_data.disp_cntl);
}

/** Turn off the blinking cursor */
void pi_lcd_blink_off(const struct device *gpio_dev)
{
    lcd_data.disp_cntl &= ~LCD_BLINK_ON;
    _pi_lcd_command(gpio_dev,
                    LCD_DISPLAY_CONTROL | lcd_data.disp_cntl);
}

/** Turn on the blinking cursor */
void pi_lcd_blink_on(const struct device *gpio_dev)
{
    lcd_data.disp_cntl |= LCD_BLINK_ON;
    _pi_lcd_command(gpio_dev,
                    LCD_DISPLAY_CONTROL | lcd_data.disp_cntl);
}

/** Scroll the display left without changing the RAM */
void pi_lcd_scroll_left(const struct device *gpio_dev)
{
    _pi_lcd_command(gpio_dev, LCD_CURSOR_SHIFT |
                    LCD_DISPLAY_MOVE | LCD_MOVE_LEFT);
}

/** Scroll the display right without changing the RAM */
void pi_lcd_scroll_right(const struct device *gpio_dev)
{
    _pi_lcd_command(gpio_dev, LCD_CURSOR_SHIFT |
                    LCD_DISPLAY_MOVE | LCD_MOVE_RIGHT);
}

/** Text that flows from left to right */
void pi_lcd_left_to_right(const struct device *gpio_dev)
{
    lcd_data.disp_mode |= LCD_ENTRY_LEFT;
    _pi_lcd_command(gpio_dev,
                    LCD_ENTRY_MODE_SET | lcd_data.disp_cntl);
}

/** Text that flows from right to left */
void pi_lcd_right_to_left(const struct device *gpio_dev)
{
    lcd_data.disp_mode &= ~LCD_ENTRY_LEFT;
    _pi_lcd_command(gpio_dev,
                    LCD_ENTRY_MODE_SET | lcd_data.disp_cntl);
}

/** Right justify text from the cursor location */
void pi_lcd_auto_scroll_right(const struct device *gpio_dev)
{
    lcd_data.disp_mode |= LCD_ENTRY_SHIFT_INCREMENT;
    _pi_lcd_command(gpio_dev,
                    LCD_ENTRY_MODE_SET | lcd_data.disp_cntl);
}

/** Left justify text from the cursor location */
void pi_lcd_auto_scroll_left(const struct device *gpio_dev)
{
    lcd_data.disp_mode &= ~LCD_ENTRY_SHIFT_INCREMENT;
    _pi_lcd_command(gpio_dev,
                    LCD_ENTRY_MODE_SET | lcd_data.disp_cntl);
}

void pi_lcd_string(const struct device *gpio_dev, char *msg)
{
    int i;
    int len = 0;
    uint8_t data;

    len = strlen(msg);
    if (len > LCD_WIDTH)
    {
        printk("Too long message! len %d %s\n", len, msg);
    }

    for (i = 0; i < len; i++)
    {
        data = msg[i];
        _pi_lcd_write(gpio_dev, data);
    }
}

/** LCD initialization function */
void pi_lcd_init(const struct device *gpio_dev, uint8_t cols, uint8_t rows,
                 uint8_t dotsize)
{
    if (rows > 1)
    {
        lcd_data.disp_func |= LCD_2_LINE;
    }
    lcd_data.cfg_rows = rows;

    _set_row_offsets(0x00, 0x40);

    /* For 1 line displays, a 10 pixel high font looks OK */
    if ((dotsize != LCD_5x8_DOTS) && (rows == 1U))
    {
        lcd_data.disp_func |= LCD_5x10_DOTS;
    }

    /* SEE PAGE 45/46 FOR INITIALIZATION SPECIFICATION!
     * according to datasheet, we need at least 40ms after power rises
     * above 2.7V before sending commands. Arduino can turn on way
     * before 4.5V so we'll wait 50
     */
    k_sleep(K_MSEC(50));

    /* this is according to the hitachi HD44780 datasheet
     * figure 23/24, pg 45/46 try to set 4/8 bits mode
     */
    if (lcd_data.disp_func & LCD_8BIT_MODE)
    {
        /* 1st try */
        _pi_lcd_command(gpio_dev, 0x30);
        k_sleep(K_MSEC(5));         /* wait for 5ms */

        /* 2nd try */
        _pi_lcd_command(gpio_dev, 0x30);
        k_sleep(K_MSEC(5));         /* wait for 5ms */

        /* 3rd try */
        _pi_lcd_command(gpio_dev, 0x30);
        k_sleep(K_MSEC(1));         /* wait for 1ms */

        /* Set 4bit interface */
        _pi_lcd_command(gpio_dev, 0x30);
    }
    else
    {
        /* 1st try */
        _pi_lcd_command(gpio_dev, 0x03);
        k_sleep(K_MSEC(5));         /* wait for 5ms */

        /* 2nd try */
        _pi_lcd_command(gpio_dev, 0x03);
        k_sleep(K_MSEC(5));         /* wait for 5ms */

        /* 3rd try */
        _pi_lcd_command(gpio_dev, 0x03);
        k_sleep(K_MSEC(1));         /* wait for 1ms */

        /* Set 4bit interface */
        _pi_lcd_command(gpio_dev, 0x02);
    }

    /* finally, set # lines, font size, etc. */
    _pi_lcd_command(gpio_dev, (LCD_FUNCTION_SET | lcd_data.disp_func));

    /* turn the display on with no cursor or blinking default */
    lcd_data.disp_cntl = LCD_DISPLAY_ON | LCD_CURSOR_OFF | LCD_BLINK_OFF;
    pi_lcd_display_on(gpio_dev);

    /* clear it off */
    pi_lcd_clear(gpio_dev);

    /* Initialize to default text direction */
    lcd_data.disp_mode = LCD_ENTRY_LEFT | LCD_ENTRY_SHIFT_DECREMENT;
    /* set the entry mode */
    _pi_lcd_command(gpio_dev, LCD_ENTRY_MODE_SET | lcd_data.disp_mode);
}
```

## src/lcd16x2.h
```c
/*
 * Copyright (c) 2022 Nuertey Odzeyem
 *
 * SPDX-License-Identifier: Apache-2.0
 */

/*
 * LCDs (Liquid Crystal Displays) are used in embedded system applications
 * for displaying various parameters and statuses of the system. The LCD
 * 16x2 has the following characteristics:
 *
 *   - It is a 16-pin device that has 2 rows that can accommodate 16
 *     characters each. The pins and their corresponding functions are:
 *
 *      [a] VSS  - Ground
 *      [b] VCC  - +5V
 *      [c] VEE  - Contrast Control
 *      [d] RS   - Register Select
 *      [e] RW   - Read/Write
 *      [f] E    - Enable
 *      [g] D0   - Data Pin 0
 *      [h] D1   - Data Pin 1
 *      [i] D2   - Data Pin 2
 *      [j] D3   - Data Pin 3
 *      [k] D4   - Data Pin 4
 *      [l] D5   - Data Pin 5
 *      [m] D6   - Data Pin 6
 *      [n] D7   - Data Pin 7
 *      [o] LED+ - LED+ 5V
 *      [p] LED- - LED- Ground
 *
 *   - It can be used either in a 4-bit mode or an 8-bit mode.
 *
 *   - For displaying on it, custom characters can be created.
 *
 *   - And lastly, the LCD 16x2 has 8 data lines and 3 control lines
 *     that can be used for control purposes.
 */

/*
 * @file Display text strings on generic LCD16x2 LCD controller
 * using GPIO for parallel interface on MCU.
 *
 * Datasheet: http://wiki.sunfounder.cc/index.php?title=LCD1602_Module
 *
 * LCD Wiring
 * ----------
 * The wiring for the LCD is as follows:
 *
 * 1 : GND
 * 2 : 5V
 * 3 : Contrast (0-5V)*
 * 4 : RS (Register Select)
 * 5 : R/W (Read Write)       - GROUND THIS PIN
 * 6 : Enable or Strobe
 * 7 : Data Bit 0             - NOT USED
 * 8 : Data Bit 1             - NOT USED
 * 9 : Data Bit 2             - NOT USED
 * 10: Data Bit 3             - NOT USED
 * 11: Data Bit 4
 * 12: Data Bit 5
 * 13: Data Bit 6
 * 14: Data Bit 7
 * 15: LCD Backlight +5V**
 * 16: LCD Backlight GND
 *
 * Every 5 second you should see this repeatedly on display:
 * 
 *     Nuertey Odzeyem
 *     NUCLEO F767ZI
 */
#pragma once
 
#include <zephyr/kernel.h>
#include <zephyr/sys/printk.h>
#include <zephyr/drivers/gpio.h>
#include <string.h>

/* Choose pins on the same port so as to make coding logic straightforward. */
#define GPIO_NODE DT_NODELABEL(gpiof)

// TBD, Nuertey Odzeyem; If using 8-bit mode, must define these pins as 
// well. For now, and to encourage compilation, simply set to an UNUSED
// dummy GPIO pin on the same port. The following satisfies:
//
// Connector: CN10 
// Pin      : 2 
// Pin Name : D7        * Arduino-equivalent pin name
// STM32 Pin: PF13
// Signal   : I/O
#define GPIO_PIN_D0       13  /* NC in 4-bit mode */
#define GPIO_PIN_D1       13  /* NC in 4-bit mode */
#define GPIO_PIN_D2       13  /* NC in 4-bit mode */
#define GPIO_PIN_D3       13  /* NC in 4-bit mode */

#define GPIO_PIN_D4        8  /* PF8 */
#define GPIO_PIN_D5        2  /* PF2 */
#define GPIO_PIN_D6        1  /* PF1 */
#define GPIO_PIN_D7        0  /* PF0 */
#define GPIO_PIN_RS        9  /* PF9 */
#define GPIO_PIN_E         7  /* PF7 */
#define GPIO_NAME         "GPIO_"

/* Commands */
#define LCD_CLEAR_DISPLAY           0x01
#define LCD_RETURN_HOME             0x02
#define LCD_ENTRY_MODE_SET          0x04
#define LCD_DISPLAY_CONTROL         0x08
#define LCD_CURSOR_SHIFT            0x10
#define LCD_FUNCTION_SET            0x20
#define LCD_SET_CGRAM_ADDR          0x40
#define LCD_SET_DDRAM_ADDR          0x80

/* Display entry mode */
#define LCD_ENTRY_RIGHT             0x00
#define LCD_ENTRY_LEFT              0x02
#define LCD_ENTRY_SHIFT_INCREMENT   0x01
#define LCD_ENTRY_SHIFT_DECREMENT   0x00

/* Display on/off control */
#define LCD_DISPLAY_ON              0x04
#define LCD_DISPLAY_OFF             0x00
#define LCD_CURSOR_ON               0x02
#define LCD_CURSOR_OFF              0x00
#define LCD_BLINK_ON                0x01
#define LCD_BLINK_OFF               0x00

/* Display/cursor shift */
#define LCD_DISPLAY_MOVE            0x08
#define LCD_CURSOR_MOVE             0x00
#define LCD_MOVE_RIGHT              0x04
#define LCD_MOVE_LEFT               0x00

/* Function set */
#define LCD_8BIT_MODE               0x10
#define LCD_4BIT_MODE               0x00
#define LCD_2_LINE                  0x08
#define LCD_1_LINE                  0x00
#define LCD_5x10_DOTS               0x04
#define LCD_5x8_DOTS                0x00

/* Define some device constants */
#define LCD_WIDTH                     16  /* Max char per line */
#define HIGH                           1
#define LOW                            0

/* in millisecond */
#define ENABLE_DELAY                  10


/******************************************
 * USER can use the APIs that follow below.
 *****************************************/ 
#define GPIO_PIN_WR(dev, pin, bit)                      \
    do {                                    \
        if (gpio_pin_set_raw((dev), (pin), (bit))) {            \
            printk("Err set " GPIO_NAME "%d! %x\n", (pin), (bit));  \
        }                               \
    } while (0)                             \

#define GPIO_PIN_CFG(dev, pin, dir)                     \
    do {                                    \
        if (gpio_pin_configure((dev), (pin), (dir))) {          \
            printk("Err cfg " GPIO_NAME "%d! %x\n", (pin), (dir));  \
        }                               \
    } while (0)

void pi_lcd_home(const struct device *gpio_dev);
void pi_lcd_set_cursor(const struct device *gpio_dev, uint8_t col, uint8_t row);
void pi_lcd_clear(const struct device *gpio_dev);
void pi_lcd_display_on(const struct device *gpio_dev);
void pi_lcd_display_off(const struct device *gpio_dev);
void pi_lcd_cursor_off(const struct device *gpio_dev);
void pi_lcd_cursor_on(const struct device *gpio_dev);
void pi_lcd_blink_off(const struct device *gpio_dev);
void pi_lcd_blink_on(const struct device *gpio_dev);
void pi_lcd_scroll_left(const struct device *gpio_dev);
void pi_lcd_scroll_right(const struct device *gpio_dev);
void pi_lcd_left_to_right(const struct device *gpio_dev);
void pi_lcd_right_to_left(const struct device *gpio_dev);
void pi_lcd_auto_scroll_right(const struct device *gpio_dev);
void pi_lcd_auto_scroll_left(const struct device *gpio_dev);
void pi_lcd_string(const struct device *gpio_dev, char *msg);
void pi_lcd_init(const struct device *gpio_dev, uint8_t cols, uint8_t rows, uint8_t dotsize);
```

## src/mqtt_publisher.c
```c
/*
 * Copyright (c) 2017 Intel Corporation
 *
 * SPDX-License-Identifier: Apache-2.0
 */

#include "mqtt_publisher.h"

LOG_MODULE_REGISTER(dht11_and_lcd16x2, LOG_LEVEL_DBG);

#if defined(CONFIG_USERSPACE)
    K_APPMEM_PARTITION_DEFINE(app_partition);
#else
#endif

#if defined(CONFIG_MQTT_LIB_TLS)
    int tls_init(void)
    {
        int err = -EINVAL;
    
    #if defined(MBEDTLS_X509_CRT_PARSE_C) || defined(CONFIG_NET_SOCKETS_OFFLOAD)
        err = tls_credential_add(APP_CA_CERT_TAG, TLS_CREDENTIAL_CA_CERTIFICATE,
                                ca_certificate, sizeof(ca_certificate));
        if (err < 0)
        {
            LOG_ERR("Failed to register public certificate: %d", err);
            return err;
        }
    #endif
    
    #if defined(MBEDTLS_KEY_EXCHANGE_SOME_PSK_ENABLED)
        err = tls_credential_add(APP_PSK_TAG, TLS_CREDENTIAL_PSK,
                                client_psk, sizeof(client_psk));
        if (err < 0)
        {
            LOG_ERR("Failed to register PSK: %d", err);
            return err;
        }
    
        err = tls_credential_add(APP_PSK_TAG, TLS_CREDENTIAL_PSK_ID,
                                client_psk_id, sizeof(client_psk_id) - 1);
        if (err < 0)
        {
            LOG_ERR("Failed to register PSK ID: %d", err);
        }
    #endif
    
        return err;
    }
#endif /* CONFIG_MQTT_LIB_TLS */

void prepare_fds(struct mqtt_client *client)
{
    if (client->transport.type == MQTT_TRANSPORT_NON_SECURE)
    {
        fds[0].fd = client->transport.tcp.sock;
    }
#if defined(CONFIG_MQTT_LIB_TLS)
    else if (client->transport.type == MQTT_TRANSPORT_SECURE)
    {
        fds[0].fd = client->transport.tls.sock;
    }
#endif

    fds[0].events = ZSOCK_POLLIN;
    nfds = 1;
}

void clear_fds(void)
{
    nfds = 0;
}

int wait(int timeout)
{
    int ret = 0;

    if (nfds > 0)
    {
        ret = zsock_poll(fds, nfds, timeout);
        if (ret < 0)
        {
            LOG_ERR("poll error: %d", errno);
        }
    }

    return ret;
}

void mqtt_evt_handler(struct mqtt_client *const client,
                      const struct mqtt_evt *evt)
{
    int err;

    switch (evt->type)
    {
    case MQTT_EVT_CONNACK:
        if (evt->result != 0)
        {
            LOG_ERR("MQTT connect failed %d", evt->result);
            break;
        }

        connected = true;
        LOG_INF("MQTT client connected!");

        break;

    case MQTT_EVT_DISCONNECT:
        LOG_INF("MQTT client disconnected %d", evt->result);

        connected = false;
        clear_fds();

        break;

    case MQTT_EVT_PUBACK:
        if (evt->result != 0)
        {
            LOG_ERR("MQTT PUBACK error %d", evt->result);
            break;
        }

        LOG_INF("PUBACK packet id: %u", evt->param.puback.message_id);

        break;

    case MQTT_EVT_PUBREC:
        if (evt->result != 0)
        {
            LOG_ERR("MQTT PUBREC error %d", evt->result);
            break;
        }

        LOG_INF("PUBREC packet id: %u", evt->param.pubrec.message_id);

        const struct mqtt_pubrel_param rel_param =
        {
            .message_id = evt->param.pubrec.message_id
        };

        err = mqtt_publish_qos2_release(client, &rel_param);
        if (err != 0)
        {
            LOG_ERR("Failed to send MQTT PUBREL: %d", err);
        }

        break;

    case MQTT_EVT_PUBCOMP:
        if (evt->result != 0)
        {
            LOG_ERR("MQTT PUBCOMP error %d", evt->result);
            break;
        }

        LOG_INF("PUBCOMP packet id: %u",
                evt->param.pubcomp.message_id);

        break;

    case MQTT_EVT_PINGRESP:
        LOG_INF("PINGRESP packet");
        break;

    default:
        break;
    }
}

int publish(struct mqtt_client *client, char * topic, char * payload)
{
    struct mqtt_publish_param param;

    param.message.topic.qos = MQTT_QOS_2_EXACTLY_ONCE;
    param.message.topic.topic.utf8 = (uint8_t *)topic;
    param.message.topic.topic.size =
        strlen(param.message.topic.topic.utf8);
    param.message.payload.data = payload;
    param.message.payload.len =
        strlen(param.message.payload.data);
    param.message_id = sys_rand32_get();
    param.dup_flag = 0U;
    param.retain_flag = 0U;

    return mqtt_publish(client, &param);
}

void broker_init(void)
{
#if defined(CONFIG_NET_IPV6)
    struct sockaddr_in6 *broker6 = (struct sockaddr_in6 *)&broker;

    broker6->sin6_family = AF_INET6;
    broker6->sin6_port = htons(SERVER_PORT);
    zsock_inet_pton(AF_INET6, SERVER_ADDR, &broker6->sin6_addr);

    #if defined(CONFIG_SOCKS)
        struct sockaddr_in6 *proxy6 = (struct sockaddr_in6 *)&socks5_proxy;
    
        proxy6->sin6_family = AF_INET6;
        proxy6->sin6_port = htons(SOCKS5_PROXY_PORT);
        zsock_inet_pton(AF_INET6, SOCKS5_PROXY_ADDR, &proxy6->sin6_addr);
    #endif
#else
    struct sockaddr_in *broker4 = (struct sockaddr_in *)&broker;

    broker4->sin_family = AF_INET;
    broker4->sin_port = htons(SERVER_PORT);
    zsock_inet_pton(AF_INET, SERVER_ADDR, &broker4->sin_addr);
    #if defined(CONFIG_SOCKS)
        struct sockaddr_in *proxy4 = (struct sockaddr_in *)&socks5_proxy;
    
        proxy4->sin_family = AF_INET;
        proxy4->sin_port = htons(SOCKS5_PROXY_PORT);
        zsock_inet_pton(AF_INET, SOCKS5_PROXY_ADDR, &proxy4->sin_addr);
    #endif
#endif
}

void client_init(struct mqtt_client *client)
{
#if defined(CONFIG_MQTT_LIB_TLS)
    int rc;

    rc = tls_init();
    PRINT_RESULT("tls_init", rc);
#endif
    
    mqtt_client_init(client);

    broker_init();

    /* MQTT client configuration */
    client->broker = &broker;
    client->evt_cb = mqtt_evt_handler;
    client->client_id.utf8 = (uint8_t *)MQTT_CLIENTID;
    client->client_id.size = strlen(MQTT_CLIENTID);
    client->password = NULL;
    client->user_name = NULL;
    client->protocol_version = MQTT_VERSION_3_1_1;

    /* MQTT buffers configuration */
    client->rx_buf = rx_buffer;
    client->rx_buf_size = sizeof(rx_buffer);
    client->tx_buf = tx_buffer;
    client->tx_buf_size = sizeof(tx_buffer);

    /* MQTT transport configuration */
#if defined(CONFIG_MQTT_LIB_TLS)
    #if defined(CONFIG_MQTT_LIB_WEBSOCKET)
        client->transport.type = MQTT_TRANSPORT_SECURE_WEBSOCKET;
    #else
        client->transport.type = MQTT_TRANSPORT_SECURE;
    #endif
    
    struct mqtt_sec_config *tls_config = &client->transport.tls.config;

    tls_config->peer_verify = TLS_PEER_VERIFY_REQUIRED;
    tls_config->cipher_list = NULL;
    tls_config->sec_tag_list = m_sec_tags;
    tls_config->sec_tag_count = ARRAY_SIZE(m_sec_tags);
    #if defined(MBEDTLS_X509_CRT_PARSE_C) || defined(CONFIG_NET_SOCKETS_OFFLOAD)
        tls_config->hostname = TLS_SNI_HOSTNAME;
    #else
        tls_config->hostname = NULL;
    #endif
    
#else
    #if defined(CONFIG_MQTT_LIB_WEBSOCKET)
        client->transport.type = MQTT_TRANSPORT_NON_SECURE_WEBSOCKET;
    #else
        client->transport.type = MQTT_TRANSPORT_NON_SECURE;
    #endif
#endif

#if defined(CONFIG_MQTT_LIB_WEBSOCKET)
    client->transport.websocket.config.host = SERVER_ADDR;
    client->transport.websocket.config.url = "/mqtt";
    client->transport.websocket.config.tmp_buf = temp_ws_rx_buf;
    client->transport.websocket.config.tmp_buf_len = sizeof(temp_ws_rx_buf);
    client->transport.websocket.timeout = 5 * MSEC_PER_SEC;
#endif

#if defined(CONFIG_SOCKS)
    mqtt_client_set_proxy(client, &socks5_proxy,
                          socks5_proxy.sa_family == AF_INET ?
                          sizeof(struct sockaddr_in) :
                          sizeof(struct sockaddr_in6));
#endif
}

/* In this routine we block until the connected variable is 1 */
int try_to_connect(struct mqtt_client *client)
{
    int rc, i = 0;

    while (i++ < APP_CONNECT_TRIES && !connected)
    {
        client_init(client);

        rc = mqtt_connect(client);
        if (rc != 0)
        {
            PRINT_RESULT("mqtt_connect", rc);
            k_sleep(K_MSEC(APP_SLEEP_MSECS));
            continue;
        }

        prepare_fds(client);

        if (wait(APP_CONNECT_TIMEOUT_MS))
        {
            mqtt_input(client);
        }

        if (!connected)
        {
            mqtt_abort(client);
        }
    }

    if (connected)
    {
        return 0;
    }

    return -EINVAL;
}

int process_mqtt_and_sleep(struct mqtt_client *client, int timeout)
{
    int64_t remaining = timeout;
    int64_t start_time = k_uptime_get();
    int rc;

    while (remaining > 0 && connected)
    {
        if (wait(remaining))
        {
            rc = mqtt_input(client);
            if (rc != 0)
            {
                PRINT_RESULT("mqtt_input", rc);
                return rc;
            }
        }

        rc = mqtt_live(client);
        if (rc != 0 && rc != -EAGAIN)
        {
            PRINT_RESULT("mqtt_live", rc);
            return rc;
        }
        else if (rc == 0)
        {
            rc = mqtt_input(client);
            if (rc != 0)
            {
                PRINT_RESULT("mqtt_input", rc);
                return rc;
            }
        }

        remaining = timeout + start_time - k_uptime_get();
    }

    return 0;
}
```

## src/mqtt_publisher.h
```c
/*
 * Copyright (c) 2022 Nuertey Odzeyem
 *
 * SPDX-License-Identifier: Apache-2.0
 */
#pragma once

#include <zephyr/logging/log.h>
#include <zephyr/kernel.h>
#include <zephyr/net/socket.h>
#include <zephyr/net/mqtt.h>
#include <zephyr/random/rand32.h>

#include <string.h>
#include <errno.h>

#include "config.h"

#define SUCCESS_OR_EXIT(rc) { if (rc != 0) { return 1; } }
#define SUCCESS_OR_BREAK(rc) { if (rc != 0) { break; } }

#define RC_STR(rc) ((rc) == 0 ? "OK" : "ERROR")

#define PRINT_RESULT(func, rc) \
    LOG_INF("%s: %d <%s>", (func), rc, RC_STR(rc))

// The static declarations that follow are for internal linkage, so that
// we don't encounter multiple symbol definition errors during linking. 

#if defined(CONFIG_USERSPACE)
    #include <zephyr/app_memory/app_memdomain.h>
    static struct k_mem_domain app_domain;
    #define APP_BMEM K_APP_BMEM(app_partition)
    #define APP_DMEM K_APP_DMEM(app_partition)
#else
    #define APP_BMEM
    #define APP_DMEM
#endif

/* Buffers for MQTT client. */
static APP_BMEM uint8_t rx_buffer[APP_MQTT_BUFFER_SIZE];
static APP_BMEM uint8_t tx_buffer[APP_MQTT_BUFFER_SIZE];

#if defined(CONFIG_MQTT_LIB_WEBSOCKET)
    /* Making RX buffer large enough that the full IPv6 packet can fit into it */
    #define MQTT_LIB_WEBSOCKET_RECV_BUF_LEN 1280
    
    /* Websocket needs temporary buffer to store partial packets */
    static APP_BMEM uint8_t temp_ws_rx_buf[MQTT_LIB_WEBSOCKET_RECV_BUF_LEN];
#endif

/* The mqtt client struct */
static APP_BMEM struct mqtt_client client_ctx;

/* MQTT Broker details. */
static APP_BMEM struct sockaddr_storage broker;

#if defined(CONFIG_SOCKS)
    static APP_BMEM struct sockaddr socks5_proxy;
#endif

static APP_BMEM struct zsock_pollfd fds[1];
static APP_BMEM int nfds;

static APP_BMEM bool connected;

#if defined(CONFIG_MQTT_LIB_TLS)
    #include "test_certs.h"
    
    #define TLS_SNI_HOSTNAME "localhost"
    #define APP_CA_CERT_TAG 1
    #define APP_PSK_TAG 2
    
    static APP_DMEM sec_tag_t m_sec_tags[] =
    {
    #if defined(MBEDTLS_X509_CRT_PARSE_C) || defined(CONFIG_NET_SOCKETS_OFFLOAD)
        APP_CA_CERT_TAG,
    #endif
    #if defined(MBEDTLS_KEY_EXCHANGE_SOME_PSK_ENABLED)
        APP_PSK_TAG,
    #endif
    };
    
    /************************************************
    * USER can use these TLS APIs that follow below.
    ************************************************/ 
    int tls_init(void);
#endif /* CONFIG_MQTT_LIB_TLS */

/******************************************
 * USER can use the APIs that follow below.
 *****************************************/ 
void prepare_fds(struct mqtt_client *client);
void clear_fds(void);
int wait(int timeout);
void mqtt_evt_handler(struct mqtt_client *const client, const struct mqtt_evt *evt);
int publish(struct mqtt_client *client, char * topic, char * payload);
void broker_init(void);
void client_init(struct mqtt_client *client);
int try_to_connect(struct mqtt_client *client);
int process_mqtt_and_sleep(struct mqtt_client *client, int timeout);
```
